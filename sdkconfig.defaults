## sdkconfig.defaults
```kconfig
CONFIG_ESP_MAIN_TASK_STACK_SIZE=3000
CONFIG_ESP_TASK_WDT=n
CONFIG_MICRO_ROS_ESP_XRCE_DDS_MIDDLEWARE=y
CONFIG_MICRO_ROS_ESP_UART_TRANSPORT=y
CONFIG_ESP32_ENABLE_UNIT_TEST=y
CONFIG_UNITY_ENABLE_IDF_TEST_RUNNER=y
```
